#include "hub75.h"
#include "pins.h"
#include "delay.h"
#include <math.h>
#include <string.h>

int hubBrightness = 50; //Brightness 2..100%; 0..1% - off
int hubMinBrightness = 2;

orient_t hubOrientation = HUB_ROTATE_0; //Display Orientation
char hubNeedRedraw = false;
	
screen_t matrix[SCREEN_PAGES];
screen_t * screen = &matrix[0], * display = &matrix[1], * screen_temp;

screen_t matrix[SCREEN_PAGES] = { 0 };

/* Connection HUB75 -> STM32F429I-DISCOVERY

	R1 ->	 PC11
	G1 ->	 PC12
	B1 ->	 PC13
	GND -> GND
	R2 ->	 PD2
	G2 ->	 PD4
	B2 ->	 PD5
	GND -> GND
	A  ->	 PE2
	B  ->  PE3
	C  ->	 PE4
	D  ->	 PE5
	CLK -> PD7
	LAT -> PG2
	NOE -> PF6 (TIM10_CH1)
	GND -> GND

	PA5 -> pin for test timings
*/

const pin_t
	hub_r1 = {
		GPIOC,
		GPIO_PIN_11
},
	hub_g1 = {
		GPIOC,
		GPIO_PIN_12
},
	hub_b1 = {
		GPIOC,
		GPIO_PIN_13
},
	hub_r2 = {
		GPIOD,
		GPIO_PIN_2
},
	hub_g2 = {
		GPIOD,
		GPIO_PIN_4
},
	hub_b2 = {
		GPIOD,
		GPIO_PIN_5
},
	hub_a = {
		GPIOE,
		GPIO_PIN_2
},
	hub_b = {
		GPIOE,
		GPIO_PIN_3
},
	hub_c = {
		GPIOE,
		GPIO_PIN_4
},
	hub_d = {
		GPIOE,
		GPIO_PIN_5
},
	hub_clk = {
		GPIOD,
		GPIO_PIN_7
},
	hub_lat = {
		GPIOG,
		GPIO_PIN_2
},
	hub_noe = {
		GPIOF,
		GPIO_PIN_6
},
	hub_time = {
	GPIOA,
	GPIO_PIN_5
};
	
#define HUB_GPIO_CLK_ENABLE() \
	__GPIOC_CLK_ENABLE(); \
	__GPIOD_CLK_ENABLE(); \
	__GPIOE_CLK_ENABLE(); \
	__GPIOG_CLK_ENABLE(); \
	__GPIOF_CLK_ENABLE()

#define NOE_TIM_CHANNEL TIM_CHANNEL_1

TIM_HandleTypeDef hubtim, hubtim2;

static void initIO(void) {
	HUB_GPIO_CLK_ENABLE();
	
	GPIO_InitTypeDef gpioInit;

	gpioInit.Mode = GPIO_MODE_OUTPUT_PP;
	gpioInit.Pull = GPIO_PULLUP;
	gpioInit.Speed = GPIO_SPEED_HIGH;

	pinSet(hub_noe);
	gpioInit.Pin = hub_noe.pin;
	HAL_GPIO_Init(hub_noe.port, &gpioInit);
	pinSet(hub_noe);
	
	gpioInit.Pin = hub_r1.pin;
	HAL_GPIO_Init(hub_r1.port, &gpioInit);
	gpioInit.Pin = hub_b1.pin;
	HAL_GPIO_Init(hub_b1.port, &gpioInit);
	gpioInit.Pin = hub_g1.pin;
	HAL_GPIO_Init(hub_g1.port, &gpioInit);
	gpioInit.Pin = hub_r2.pin;
	HAL_GPIO_Init(hub_r2.port, &gpioInit);
	gpioInit.Pin = hub_g2.pin;
	HAL_GPIO_Init(hub_g2.port, &gpioInit);
	gpioInit.Pin = hub_b2.pin;
	HAL_GPIO_Init(hub_b2.port, &gpioInit);
	gpioInit.Pin = hub_a.pin;
	HAL_GPIO_Init(hub_a.port, &gpioInit);
	gpioInit.Pin = hub_b.pin;
	HAL_GPIO_Init(hub_b.port, &gpioInit);
	gpioInit.Pin = hub_c.pin;
	HAL_GPIO_Init(hub_c.port, &gpioInit);
	gpioInit.Pin = hub_d.pin;
	HAL_GPIO_Init(hub_d.port, &gpioInit);
	gpioInit.Pin = hub_clk.pin;
	HAL_GPIO_Init(hub_clk.port, &gpioInit);
	gpioInit.Pin = hub_lat.pin;
	HAL_GPIO_Init(hub_lat.port, &gpioInit);
	gpioInit.Pin = hub_time.pin;
	HAL_GPIO_Init(hub_time.port, &gpioInit);
	
	/**TIM10 GPIO Configuration    
   PF6     ------> TIM10_CH1 => NOE
  */
  gpioInit.Pin = GPIO_PIN_6;
  gpioInit.Mode = GPIO_MODE_AF_PP;
  gpioInit.Pull = GPIO_PULLUP;
  gpioInit.Speed = GPIO_SPEED_HIGH;
  gpioInit.Alternate = GPIO_AF3_TIM10;
  HAL_GPIO_Init(GPIOF, &gpioInit);
}

static int period0, period1, periodDark;

#define HUB_PRESCALER (HUB_TIMER_MHZ >> 1) // 500nS - for tick
#define FRAME_PERIOD (HUB_TIMER_MHZ * 1000000 / HUB_PRESCALER / HUB_UPDATE_HZ)
#define PERIOD0 (HUB_TIMER_MHZ * HUB_PERIOD0_US / HUB_PRESCALER)

static int prescaler2N[HUB_COLOR_DEPTH];
static int prescaler2n;
static int period1N[HUB_COLOR_DEPTH];
static int period1n;
static int period2Min, period2Max;

#define P1_KOEFF(x) (100 * (x) / 100 ) // equal to p2 

static inline void setBrightness(void) {
	int sum = 0, p1, p2, bit, k;
	if (hubBrightness < hubMinBrightness) hubBrightness = 0;
	else if (hubBrightness > 100) hubBrightness = 100;
	period2Max = HUB_PERIOD2_MAX_NS / HUB_TIMER2_NS * hubBrightness / 100;
	period2Min = HUB_PERIOD2_MIN_NS / HUB_TIMER2_NS;

	if (period1 < HUB_MIN_PERIOD) period1 = HUB_MIN_PERIOD;
	
	bit = HUB_COLOR_BIT0;
	k = (period2Max - period2Min) / (HUB_COLOR_BIT0 - 1);
	for (int i = HUB_COLOR_I0; i >= 0; i--) {
		p2 = k * (bit - 1) + period2Min;
		prescaler2N[i] = p2 / period2Min;
		p1 = P1_KOEFF(p2) / HUB_PRESCALER;
		if (p1 < HUB_MIN_PERIOD) p1 = HUB_MIN_PERIOD;
		period1N[i] = p1;
		sum += p1;
		bit >>= 1;
	}
	periodDark = FRAME_PERIOD - HUB_ROWS * (period0 * HUB_COLOR_DEPTH + sum);

	HUB_TIMER2->CCR1 = period2Min;
}

static void calculatePeriod(void) {
	period0 = PERIOD0;
	if (period0 < HUB_MIN_PERIOD) period0 = HUB_MIN_PERIOD;
	setBrightness();
}	

uint16_t hubLUT[HUB_LUT_NUM] = { 0 };
	
static float gamma(float br) {
	float res = 0.0f;
	if (br < 0.0f) br = 0.0f;
	else if (br > 1.0f) br = 1.0f;
	res = (float)pow(br, HUB_GAMMA);
	if (res < 0.0f) res = 0.0f;
	else if (res > 1.0f) res = 1.0f;
	return res;
}
void hubLUTInit(void) {
	float y;
	for (int i = 0; i < HUB_LUT_NUM; i++) {
		//hubLUT[i] = i; // 256-colors
		y = (HUB_COLOR_NUM - 1.5) * gamma((float)i / (HUB_LUT_NUM - 1)) + 0.5;
		hubLUT[i] = (int)y;
	}
}

const uint32_t testBmp[SCREEN_H * SCREEN_W] = { 0x2d00, 0x2d00, 0x2d00, 0x2d00, 0x2d00, 0x2d00, 0x2d00, 0x2d00, 0x2d00, 0x2d00, 0x607d54, 0x61794f, 0x63754f,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 0x2d00, 0x2d00 };
	
static  void hubTestBmp(void) {
	copyScreen(screen, (screen_t *)testBmp);
}	

static int row, colorBit, colorI;

static enum hub_state {
	ST_PERIOD0 = 0,
	ST_PERIOD1,
	ST_PERIOD_DARK
} state;

static void initRows() {
	row = 0;
	colorBit = HUB_COLOR_BIT0;
	colorI = HUB_COLOR_I0;
	state = ST_PERIOD0;
}

int screenW, screenH;

static int screen_dx, screen_dy;
static int screen0;

static orient_t currentOrient = HUB_ROTATE_NOTSET;

void hubSetOrient(orient_t orient) {
	hubOrientation = orient;
	switch (hubOrientation) {
		case HUB_ROTATE_90:
			screenW = SCREEN_H;
			screenH = SCREEN_W;
			break;

		case HUB_ROTATE_180:
			screenW = SCREEN_W;
			screenH = SCREEN_H;
			break;

		case HUB_ROTATE_270:
			screenW = SCREEN_H;
			screenH = SCREEN_W;
			break;

		case HUB_ROTATE_0:
		default:
			screenW = SCREEN_W;
			screenH = SCREEN_H;
			break;
	}
}

static inline void setOrientSwap() {
	if (hubOrientation != currentOrient) {
		currentOrient = hubOrientation;
		switch (currentOrient) {
			case HUB_ROTATE_90:
				screen_dx = -screenW;
				screen_dy = 1;
				screen0 = screenW * (screenH - 1);
				break;

			case HUB_ROTATE_180:
				screen_dx = -1;
				screen_dy = -screenW;
				screen0 = SCREEN_LEN - 1;
				break;

			case HUB_ROTATE_270:
				screen_dx = screenW;
				screen_dy = -1;
				screen0 = screenW - 1;
				break;

			case HUB_ROTATE_0:
			default:
				screen_dx = 1;
				screen_dy = screenW;
				screen0 = 0;
				break;
		}
	}
}

void hubInit(void) {
	initIO();
	calculatePeriod();
	hubLUTInit();
	initRows();
	hubOrientation = HUB_ROTATE_0;
	hubSetOrient(hubOrientation);
	clearScreen();
	//fillScreen(COLOR_RGB(255, 255, 255));
	hubTestBmp();
	screenRedraw();
	
	// 100 Hz * 16 Phases
  HUB_TIMER_CLK_ENABLE();
  TIM_ClockConfigTypeDef sClockSourceConfig;

  hubtim.Instance = HUB_TIMER;
  hubtim.Init.Prescaler = HUB_PRESCALER - 1;
  hubtim.Init.CounterMode = TIM_COUNTERMODE_UP;
  hubtim.Init.Period = period0 - 1;
  hubtim.Init.ClockDivision = TIM_CLOCKDIVISION_DIV1;
  HAL_TIM_Base_Init(&hubtim);

  sClockSourceConfig.ClockSource = TIM_CLOCKSOURCE_INTERNAL;
  HAL_TIM_ConfigClockSource(&hubtim, &sClockSourceConfig);

	HAL_NVIC_SetPriorityGrouping(NVIC_PRIORITYGROUP_4);
  HAL_NVIC_SetPriority(TIM1_BRK_TIM9_IRQn, 0, 0);
  HAL_NVIC_EnableIRQ(TIM1_BRK_TIM9_IRQn);
	
	HAL_TIM_Base_Start_IT(&hubtim);
	
	// Timer 2 for NOE
	HUB_TIMER2_CLK_ENABLE();

  TIM_OC_InitTypeDef sConfigOC;

  hubtim2.Instance = HUB_TIMER2;
  hubtim2.Init.Prescaler = 0;
  hubtim2.Init.CounterMode = TIM_COUNTERMODE_UP;
  hubtim2.Init.Period = 0xffff;
  hubtim2.Init.ClockDivision = TIM_CLOCKDIVISION_DIV1;
  HAL_TIM_Base_Init(&hubtim2);

  HAL_TIM_OC_Init(&hubtim2);

  sConfigOC.OCMode = TIM_OCMODE_PWM1;
  sConfigOC.Pulse = period2Min;
  sConfigOC.OCPolarity = TIM_OCPOLARITY_LOW;
  sConfigOC.OCFastMode = TIM_OCFAST_DISABLE;
  HAL_TIM_OC_ConfigChannel(&hubtim2, &sConfigOC, NOE_TIM_CHANNEL);

	HAL_TIM_PWM_Start(&hubtim2, NOE_TIM_CHANNEL); 

}

static inline void outputRow(void) {
	pinWrite(hub_a, row & 1);
	pinWrite(hub_b, row & 2);
	pinWrite(hub_c, row & 4);
	pinWrite(hub_d, row & 8);
}

static 	color_t * buf, * buf2, * bufLine, * bufLine2;
static int period1n;

static inline void hubTask() {
	color_t pixel, pixel2;

	if (state == ST_PERIOD0) {
		//Period 0 - Shift row data
		pinReset(hub_time);
		//__HAL_TIM_SetAutoreload(&hubtim, period0 - 1);
		HUB_TIMER->ARR = period0 - 1;
		
		if (colorBit == HUB_COLOR_BIT0) {
			if (row == 0) {
				//Begin of Frame
				setBrightness();
				if (hubBrightness == 0) {
					//Display turn off
					//__HAL_TIM_SetAutoreload(&hubtim, FRAME_PERIOD - 1);
					HUB_TIMER->ARR = FRAME_PERIOD - 1;

					pinSet(hub_time);
					return;
				}
				if (hubNeedRedraw) {
					swapPages();
					setOrientSwap();
				}	
				bufLine = &DISPLAY[screen0];
				bufLine2 = &bufLine[HUB_ROWS * screen_dy];
			}
			outputRow();
		}
	
		int red, green, blue;
		int red2, green2, blue2;
		buf = bufLine;
		buf2 = bufLine2;
		for (int x = 0; x < SCREEN_W; x++) {
			pixel = *buf;
			red = hubLUT[pixel.R];
			green = hubLUT[pixel.G];
			blue = hubLUT[pixel.B];

			pixel2 = *buf2;
			red2 = hubLUT[pixel2.R];
			green2 = hubLUT[pixel2.G];
			blue2 = hubLUT[pixel2.B];

			pinReset(hub_clk);
			
			pinWrite(hub_r1, red & colorBit);
			pinWrite(hub_g1, green & colorBit);
			pinWrite(hub_b1, blue & colorBit);
			
			pinWrite(hub_r2, red2 & colorBit);
			pinWrite(hub_g2, green2 & colorBit);
			pinWrite(hub_b2, blue2 & colorBit);
			
			buf += screen_dx;
			buf2 += screen_dx;
		
			pinSet(hub_clk);
		}
		period1n = period1N[colorI];
		prescaler2n = prescaler2N[colorI];
		colorBit >>= 1;
		colorI--;
		if (colorBit == 0) {
			colorBit = HUB_COLOR_BIT0;
			colorI = HUB_COLOR_I0;
			//Change Row
			row = (row + 1) & HUB_ROWS_MASK;
			bufLine += screen_dy;
			bufLine2 += screen_dy;
		}	
		pinSet(hub_lat);
		state = ST_PERIOD1;
		pinReset(hub_lat);
	} else if (state == ST_PERIOD1) {
		//Period 1 - Show current row
		
		//Set prescaler
		HUB_TIMER2->PSC = prescaler2n - 1;
		//Update Event Generation
		HUB_TIMER2->EGR = TIM_EGR_UG;
		//Enable Timer
		HUB_TIMER2->CR1 |= TIM_CR1_CEN;
		//Set Period
		//__HAL_TIM_SetAutoreload(&hubtim, period1n - 1);
		HUB_TIMER->ARR = period1n - 1;
		state = ST_PERIOD0;
		if ((colorBit == HUB_COLOR_BIT0) && (row == 0)) {
			//Last pixels
			state = ST_PERIOD_DARK;
		}
	}	else if (state == ST_PERIOD_DARK) {
		//Period Dark - End of frame
		//Set period
		HUB_TIMER->ARR = periodDark - 1;
		//Disable Timer
		HUB_TIMER2->CR1 &= ~TIM_CR1_CEN;

		state = ST_PERIOD0;
	}

	pinSet(hub_time);
}

void TIM1_BRK_TIM9_IRQHandler(void)
{
	//if (__HAL_TIM_GET_ITSTATUS(&hubtim, TIM_IT_UPDATE) != RESET) {
	if ((HUB_TIMER->DIER & TIM_IT_UPDATE) != 0) {	
		hubTask();
		//__HAL_TIM_CLEAR_IT(&hubtim, TIM_IT_UPDATE);
		(HUB_TIMER->SR = ~(TIM_IT_UPDATE));
	}
	//HAL_NVIC_ClearPendingIRQ(TIM1_BRK_TIM9_IRQn);
	NVIC->ICPR[TIM1_BRK_TIM9_IRQn >> 5] = 1 << TIM1_BRK_TIM9_IRQn;
}

void inline clearScreen(void) {
	memset(screen, 0, SCREEN_BYTES);
}

void inline copyScreen(screen_t * dst, screen_t * src) {
	memmove(dst, src, SCREEN_BYTES);
}

void fillScreen(color_t color) {
	color_t * sc = (color_t *)screen;
	for (int i = 0; i < SCREEN_LEN; i++) {
		*sc = color;
		sc++;
	}
}
